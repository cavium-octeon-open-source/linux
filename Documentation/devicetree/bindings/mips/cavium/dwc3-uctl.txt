## Documentation/devicetree/bindings/mips/cavium/dwc3-uctl.txt
```
* UCTL USB controller glue for DesignWare USB3 DRD

Required properties:

- compatible: "cavium,octeon-7130-usb-uctl"

  Compatibility with the cn7130 SOC.

- reg: The base address of the UCTL register bank.

- #address-cells, #size-cells, and ranges must be present and hold
        suitable values to map all child nodes.

- refclk-frequency: A single cell containing the reference clock
  frequency in Hz.

- refclk-type: A string describing the reference clock connection
  either "crystal" or "external".

- refclk-frequency: A single cell containing the frequency of the
  dlmc_ref_clk0, dlmc_ref_clk1 reference clocks.
  50MHz, 100MHz and 125MHz allowed

- refclk-type-ss: A string describing the reference clock connection for
  SuperSpeed function, dlmc_ref_clk0 or pll_ref_clk

- refclk-type-hs:  A string describing the reference clock connection for
  SuperSpeed function, dlmc_ref_clk0, dlmc_ref_clk1 or pll_ref_clk

	Only four combinations of reference clocks allowed:

	1. dlmc_ref_clk0 for SS, dlmc_ref_clk0 for HS
	2. dlmc_ref_clk1 for SS, dlmc_ref_clk1 for HS
	3. dlmc_ref_clk0 for SS, pll_ref_clk for HS
	4. pll_ref_clk   for SS, pll_ref_clk for HS

	In cases 1. and 2. refclk-frequency should be 100MHz

Example:

	uctl@1180068000000 {
		compatible = "cavium,octeon-7130-usb-uctl";
		reg = <0x11800 0x68000000 0x0 0x100>;
		ranges; /* Direct mapping */
		#address-cells = <2>;
		#size-cells = <2>;
		/* 50MHz, 100MHz and 125MHz allowed */
		refclk-frequency = <100000000>;
		/* Either "dlmc_ref_clk0" "dlmc_ref_clk1" or "pll_ref_clk" */
		refclk-type-ss = "dlmc_ref_clk0";
		/* Either "dlmc_ref_clk0" "dlmc_ref_clk1" or "pll_ref_clk" */
		refclk-type-hs = "pll_ref_clk";

		xhci@1680000000000 {
			compatible = "cavium,octeon-7130-xhci","synopsys,dwc3";
			reg = <0x16800 0x00000000 0x10 0x0>;
			interrupt-parent = <&cibusb0>;
			interrupts = <9 4>; /* Bit: 9, level */
		};
	};
```

## Documentation/devicetree/bindings/mips/cavium/sata-uctl.txt
```
* UCTL SATA controller glue

Properties:
- compatible: "cavium,octeon-7130-sata-uctl"

  Compatibility with the cn7130 SOC.

- reg: The base address of the UCTL register bank.

- #address-cells, #size-cells, and ranges must be present and hold
	suitable values to map all child nodes.

Example:

	uctl@118006c000000 {
		compatible = "cavium,octeon-7130-sata-uctl";
		reg = <0x11800 0x6c000000 0x0 0x100>;
		ranges; /* Direct mapping */
		#address-cells = <2>;
		#size-cells = <2>;

		sata: sata@16c0000000000 {
			compatible = "cavium,octeon-7130-ahci";
			reg = <0x16c00 0x00000000 0x0 0x200>;
			interrupt-parent = <&cibsata>;
			interrupts = <2 4>; /* Bit: 2, level */
		};
	};
```

## Documentation/devicetree/bindings/mmc/octeon-mmc.txt
```
* OCTEON SD/MMC Host Controller

This controller is present on some members of the Cavium OCTEON SoC
family, provide an interface for eMMC, MMC and SD devices.  There is a
single controller ("unit") that may have several hosts connected.  These
hosts appear as children of the main controller node.
The DMA engine is an integral part of the controller block.

Required properties:
- compatible :
	Should be "cavium,octeon-6130-mmc-unit" or "cavium,octeon-7890-mmc-unit"
- reg : Two entries:
	1) The base address of the MMC controller register bank.
	2) The base address of the MMC DMA engine register bank.
- interrupts :
	For "cavium,octeon-6130-mmc": two entries:
	1) The MMC controller interrupt line.
	2) The MMC DMA engine interrupt line.
	For "cavium,octeon-7890-mmc": nine entries:
	1) The next block transfer of a multiblock transfer has completed (BUF_DONE)
	2) Operation completed successfully (CMD_DONE).
	3) DMA transfer completed successfully (DMA_DONE).
	4) Operation encountered an error (CMD_ERR).
	5) DMA transfer encountered an error (DMA_ERR).
	6) Switch operation completed successfully (SWITCH_DONE).
	7) Switch operation encountered an error (SWITCH_ERR).
	8) Internal DMA engine request completion interrupt (DONE).
	9) Internal DMA FIFO underflow (FIFO).
- #address-cells : Must be <1>
- #size-cells : Must be <0>

Optional properties:
- cavium,vmmc-global-supply : phandle to the regulator device tree node
	that supplies power to all hosts


Required properties of child nodes:
- compatible : Should be "cavium,octeon-6130-mmc".
- reg : The slot number.

Optional properties of child nodes:
- cavium,cmd-clk-skew : the amount of delay (in pS) past the clock edge
	to sample the command pin.
- cavium,dat-clk-skew : the amount of delay (in pS) past the clock edge
	to sample the data pin.
- vmmc-supply: phandle to the regulator device tree node
- other mmc properties as described in mmc.txt

Example:
	mmc@1180000002000 {
		compatible = "cavium,octeon-6130-mmc-unit";
		reg = <0x11800 0x00002000 0x0 0x100>,
		      <0x11800 0x00000168 0x0 0x20>;
		#address-cells = <1>;
		#size-cells = <0>;
		/* EMM irq, DMA irq */
		interrupts = <1 19>, <0 63>;
		cavium,vmmc-global-supply = <&regmmc>;

		/* The board only has a single MMC slot */
		mmc-slot@0 {
			compatible = "cavium,octeon-6130-mmc";
			reg = <0>;
			max-frequency = <26000000>;
			wp-gpios = <&gpio 4 0>;
			cd-gpios = <&gpio 3 1>;
			bus-width = <8>;
		};
	};
```

## Documentation/devicetree/bindings/pinctrl/cavium,octeon-xxxx-gpio.txt
```
* General Purpose Input Output (GPIO) bus.

Properties:
- compatible: "cavium,octeon-3860-gpio", "cavium,octeon-7130-gpio"

  Compatibility with all cn3XXX, cn5XXX, cn6XXX and cn71XX SOCs.

- reg: The base address of the GPIO unit's register bank.

- gpio-controller: This is a GPIO controller.

- #gpio-cells: Must be <2>.  The first cell is the GPIO pin.

- interrupt-controller: The GPIO controller is also an interrupt
  controller, many of its pins may be configured as an interrupt
  source.

- #interrupt-cells: Must be <2>.  The first cell is the GPIO pin
   connected to the interrupt source.  The second cell is the interrupt
   triggering protocol and may have one of four values:
   1 - edge triggered on the rising edge.
   2 - edge triggered on the falling edge
   4 - level triggered active high.
   8 - level triggered active low.

- interrupts: Interrupt routing for each pin.

GPIO controller on cn7130 supports muxing functions.  If the device is
compatible with "cavium,octeon-7130-gpio", a pinctrl device with pinmux is
registered by the driver.  It declares 20 groups "grp0".."grp19"
of single pin "pinX" each.  Each group supports any of these functions:

"PTP_CKOUT",
"PTP_PPS",
"CLK_SYNCE0",
"CLK_SYNCE1",
"MCD0" (MCD0 multicore debug output),
"MCD1" (MCD1 multicore debug output),
"MCD2" (MCD2 multicore debug output),
"LMC_ECC" (LMC_ECC(0) LMC ECC error detected),
"GPIO_CLK_GEN0" (GPIO_CLK_GEN0, GPIO clock generator),
"GPIO_CLK_GEN1" (GPIO_CLK_GEN1, GPIO clock generator),
"GPIO_CLK_GEN2" (GPIO_CLK_GEN2, GPIO clock generator),
"GPIO_CLK_GEN3" (GPIO_CLK_GEN3, GPIO clock generator),
"USB0_VBUS_CTRL" (USB0 Vbus Control),
"SATA0_COLD_PRESENCE" (SATA port0 cold presence power-on device. (p0_cp_pod)),
"SATA1_COLD_PRESENCE" (SATA port1 cold presence power-on device. (p1_cp_pod)),
"SATA0_LED" (SATA port0 LED (p0_act_led)),
"SATA1_LED" (SATA port1 LED (p1_act_led)),
"USB1_VBUS_CTRL" (USB1 Vbus control),

Additional properties for cn713-compatible devices:

- gpio-ranges - should be "<&gpio 0 0 20>;", where "gpio" points to this
  device' node.  This establishes 1-to-1 correspondence between pins and gpio
  as described in Documentation/devicetree/bindings/gpio/gpio.txt

- Generic pin configuration nodes - as described in
  Documentation/devicetree/bindings/pinctrl/pinctrl-bindings.txt, section
  "Generic pin multiplexing node content"

Example:

	gpio-controller@1070000000800 {
		#gpio-cells = <2>;
		compatible = "cavium,octeon-7130-gpio";
		reg = <0x10700 0x00000800 0x0 0x100>;
		gpio-controller;
		/* Interrupts are specified by two parts:
		 * 1) GPIO pin number (0..15)
		 * 2) Triggering (1 - edge rising
		 *		  2 - edge falling
		 *		  4 - level active high
		 *		  8 - level active low)
		 */
		interrupt-controller;
		#interrupt-cells = <2>;
		/* The GPIO pin connect to 16 consecutive CUI bits */
		interrupts = <0 16>, <0 17>, <0 18>, <0 19>,
			     <0 20>, <0 21>, <0 22>, <0 23>,
			     <0 24>, <0 25>, <0 26>, <0 27>,
			     <0 28>, <0 29>, <0 30>, <0 31>;
		gpio-ranges = <&gpio 0 0 20>;
		usb0_vbus_mode: usb0-vbus {
			function = "USB0_VBUS_CTRL";
			groups = "grp1";
		};
		usb1_vbus_mode: usb1-vbus {
			function = "USB1_VBUS_CTRL";
			groups = "grp2";
		};
	};

	...

	xhci@1680000000000 {
		compatible = "cavium,octeon-7130-xhci","synopsys,dwc3";

		...

		pinctrl-names = "default";
		pinctrl-0 = <&usb0_vbus_mode>;
	};
```
